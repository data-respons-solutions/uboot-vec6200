## Kconfig
```kconfig
if TARGET_VEC6200

config SYS_BOARD
	default "vec6200"

config SYS_VENDOR
	default "datarespons"

config SYS_CONFIG_NAME
	default "vec6200"

endif

source "board/datarespons/common/Kconfig"
```

## configs/vec6200_defconfig
```kconfig
CONFIG_ARM=y
CONFIG_ARCH_MX6=y
CONFIG_SYS_TEXT_BASE=0x11C00000
CONFIG_SYS_SPI_U_BOOT_OFFS=0x30000
CONFIG_TARGET_VEC6200=y
CONFIG_SYS_EXTRA_OPTIONS="IMX_CONFIG=board/datarespons/vec6200/mx6.cfg,MX6QDL"
CONFIG_BOOTDELAY=0
CONFIG_AUTOBOOT_NOABORT=y
CONFIG_HUSH_PARSER=y
CONFIG_ERRNO_STR=y
CONFIG_DR_BOARD_LATE_INIT=y
CONFIG_CMD_BOOTZ=y
CONFIG_CMD_MMC=y
CONFIG_CMD_I2C=y
CONFIG_CMD_USB=y
CONFIG_CMD_USB_MASS_STORAGE=y
CONFIG_CMD_GPIO=y
CONFIG_CMD_DHCP=y
CONFIG_CMD_MII=y
CONFIG_CMD_MDIO=y
CONFIG_CMD_PING=y
CONFIG_CMD_NET=y
CONFIG_CMD_CACHE=y
CONFIG_CMD_EXT2=y
CONFIG_CMD_EXT4=y
CONFIG_CMD_GPT=y
CONFIG_CMD_FAT=y
CONFIG_CMD_FS_GENERIC=y
CONFIG_CMD_PART=y
CONFIG_IMX_HAB=y
CONFIG_PARTITIONS=y
CONFIG_PARTITION_UUIDS=y
CONFIG_PARTITION_TYPE_GUID=y
CONFIG_CMD_DR_NVRAM=y
CONFIG_DR_NVRAM_BUS=1
CONFIG_DR_NVRAM_CS=0
CONFIG_DR_NVRAM_SPEED=20000000
CONFIG_DR_NVRAM_MODE=0x3
CONFIG_DR_NVRAM_SECTION_A_START=0xB0000
CONFIG_DR_NVRAM_SECTION_A_SIZE=0x10000
CONFIG_DR_NVRAM_SECTION_B_START=0xc0000
CONFIG_DR_NVRAM_SECTION_B_SIZE=0x10000
CONFIG_DR_NVRAM_BOOT_SWAP=y
CONFIG_CMD_SF=y
CONFIG_SF_DEFAULT_BUS=1
CONFIG_SF_DEFAULT_CS=0
CONFIG_SF_DEFAULT_SPEED=20000000
CONFIG_SF_DEFAULT_MODE=0x3
CONFIG_CMD_DM=y
CONFIG_CMD_CRC32=y
CONFIG_DM_MMC=y
CONFIG_FSL_USDHC=y
CONFIG_USB=y
CONFIG_DM_USB=y
CONFIG_USB_STORAGE=y
CONFIG_USB_GADGET=y
CONFIG_USB_GADGET_VENDOR_NUM=0x15a2
CONFIG_USB_GADGET_PRODUCT_NUM=0x1111
CONFIG_USB_GADGET_MANUFACTURER="datarespons"
CONFIG_USB_GADGET_DOWNLOAD=y
CONFIG_IMX_WATCHDOG=y
CONFIG_IMX_THERMAL=y
CONFIG_DM_SERIAL=y
CONFIG_MXC_UART=y
CONFIG_DM_GPIO=y
CONFIG_MXC_GPIO=y
CONFIG_DM_I2C=y
CONFIG_DM_PMIC=y
CONFIG_DM_PMIC_PFUZE100=y
CONFIG_DM_REGULATOR=y
CONFIG_DM_REGULATOR_PFUZE100=y
CONFIG_DM_REGULATOR_FIXED=y
CONFIG_DM_REGULATOR_GPIO=y
CONFIG_DM_ETH=y
CONFIG_FEC_MXC=y
CONFIG_PHYLIB=y
CONFIG_PHY_ATHEROS=y
CONFIG_SPI=y
CONFIG_DM_SPI=y
CONFIG_SPI_FLASH=y
CONFIG_DM_SPI_FLASH=y
CONFIG_SPI_FLASH_SST=y
CONFIG_MXC_SPI=y
CONFIG_OF_CONTROL=y
CONFIG_PINCTRL=y
CONFIG_PINCTRL_IMX6=y
CONFIG_DEFAULT_DEVICE_TREE="vec6200-dl-revA"
CONFIG_OF_LIBFDT=y
CONFIG_CI_UDC=y
CONFIG_FSL_CAAM=y
CONFIG_SHA256=y
CONFIG_SPL=y
CONFIG_SPL_GPIO_SUPPORT=y
CONFIG_SPL_OF_CONTROL=y
CONFIG_SPL_LIBCOMMON_SUPPORT=y
CONFIG_SPL_LIBGENERIC_SUPPORT=y
CONFIG_SPL_SERIAL_SUPPORT=y
CONFIG_SPL_WATCHDOG_SUPPORT=y
CONFIG_SPL_USB_GADGET=y
CONFIG_SPL_USB_SDP_SUPPORT=y
CONFIG_SPL_USB_HOST_SUPPORT=y
CONFIG_SPL_SPI_FLASH_SUPPORT=y
CONFIG_SPL_SPI_SUPPORT=y
CONFIG_SPL_SPI_LOAD=y
```
